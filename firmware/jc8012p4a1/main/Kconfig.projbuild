## firmware/jc8012p4a1/main/Kconfig.projbuild
```kconfig
menu "SDS200 Panel"

    choice SDS_PANEL_REV
        prompt "Default LCD panel revision"
        default SDS_PANEL_REV_V2
        help
            The JC8012P4A1 shipped with two different JD9365 panels. Boards from
            batch 2627 and earlier use the original panel; batch 2628 and later
            use the "V2" panel with a different initialisation sequence. The
            revision can also be changed at runtime from the Settings screen
            (stored in NVS, applied on reboot).

        config SDS_PANEL_REV_V1
            bool "Original panel (batch <= 2627)"
        config SDS_PANEL_REV_V2
            bool "V2 panel (batch >= 2628)"
    endchoice

    config SDS_PANEL_REV_DEFAULT
        int
        default 1 if SDS_PANEL_REV_V1
        default 2

    choice SDS_ROTATION
        prompt "Default landscape rotation"
        default SDS_ROTATION_90
        help
            The panel is natively 800x1280 portrait. The UI is rendered in
            landscape and rotated by the PPA. "Flip 180" in Settings toggles
            between the two options at runtime.

        config SDS_ROTATION_90
            bool "90 degrees"
        config SDS_ROTATION_270
            bool "270 degrees"
    endchoice

    config SDS_TOUCH_SWAP_XY
        bool "Touch: swap X/Y in native (portrait) orientation"
        default n
    config SDS_TOUCH_MIRROR_X
        bool "Touch: mirror X in native (portrait) orientation"
        default n
    config SDS_TOUCH_MIRROR_Y
        bool "Touch: mirror Y in native (portrait) orientation"
        default y
        help
            Guition's reference code uses mirror_y for the GSL3680 in portrait.
            LVGL then applies the display rotation to touch points itself.

    config SDS_DEFAULT_WIFI_SSID
        string "Default Wi-Fi SSID (optional)"
        default ""
        help
            Used only when no credentials have been saved in NVS.

    config SDS_DEFAULT_WIFI_PASSWORD
        string "Default Wi-Fi password (optional)"
        default ""

    config SDS_DEFAULT_SCANNER_IP
        string "Default scanner IP address (optional)"
        default ""

    config SDS_WEB_SERVER
        bool "Enable HTTP API on port 80"
        default y
        help
            GET /api/state and POST /api/control/key. No authentication: only
            enable on a trusted network.

endmenu
```

## firmware/jc8012p4a1/sdkconfig.defaults
```kconfig
# SDS200 Panel - Guition JC8012P4A1 (ESP32-P4 + ESP32-C6 via ESP-Hosted SDIO)
CONFIG_IDF_TARGET="esp32p4"
CONFIG_IDF_EXPERIMENTAL_FEATURES=y

# Flash / partitions
CONFIG_ESPTOOLPY_FLASHSIZE_16MB=y
CONFIG_ESPTOOLPY_FLASHMODE_QIO=y
CONFIG_ESPTOOLPY_FLASHFREQ_80M=y
CONFIG_PARTITION_TABLE_CUSTOM=y
CONFIG_PARTITION_TABLE_CUSTOM_FILENAME="partitions.csv"
CONFIG_COMPILER_OPTIMIZATION_PERF=y

# CPU / RTOS
CONFIG_ESP_DEFAULT_CPU_FREQ_MHZ_360=y
CONFIG_FREERTOS_HZ=1000
CONFIG_ESP_MAIN_TASK_STACK_SIZE=8192
CONFIG_ESP_TASK_WDT_TIMEOUT_S=10

# PSRAM 32 MB, 200 MHz
CONFIG_SPIRAM=y
CONFIG_SPIRAM_SPEED_200M=y
CONFIG_SPIRAM_USE_MALLOC=y
CONFIG_SPIRAM_MALLOC_ALWAYSINTERNAL=4096
CONFIG_SPIRAM_MALLOC_RESERVE_INTERNAL=65536
CONFIG_SPIRAM_TRY_ALLOCATE_WIFI_LWIP=y
CONFIG_SPIRAM_ALLOW_BSS_SEG_EXTERNAL_MEMORY=y
CONFIG_CACHE_L2_CACHE_256KB=y
CONFIG_CACHE_L2_CACHE_LINE_128B=y

# ESP-Hosted: ESP32-C6 co-processor over 4-bit SDIO, slot 1
CONFIG_ESP_HOSTED_ENABLED=y
CONFIG_ESP_HOSTED_CP_TARGET_ESP32C6=y
CONFIG_ESP_HOSTED_SDIO_HOST_INTERFACE=y
CONFIG_ESP_HOSTED_SDIO_SLOT_1=y
CONFIG_ESP_HOSTED_SDIO_4_BIT_BUS=y
CONFIG_ESP_HOSTED_SDIO_CLOCK_FREQ_KHZ=20000
CONFIG_ESP_HOSTED_SDIO_PIN_CLK=18
CONFIG_ESP_HOSTED_SDIO_PIN_CMD=19
CONFIG_ESP_HOSTED_SDIO_PIN_D0=14
CONFIG_ESP_HOSTED_SDIO_PIN_D1=15
CONFIG_ESP_HOSTED_SDIO_PIN_D2=16
CONFIG_ESP_HOSTED_SDIO_PIN_D3=17
CONFIG_ESP_HOSTED_SDIO_GPIO_RESET_SLAVE=54
CONFIG_ESP_HOSTED_SDIO_RESET_ACTIVE_HIGH=y
CONFIG_ESP_HOSTED_CLI_ENABLED=n
CONFIG_SLAVE_IDF_TARGET_ESP32C6=y

# LwIP / networking
CONFIG_LWIP_MAX_SOCKETS=16
CONFIG_LWIP_SO_RCVBUF=y
CONFIG_HTTPD_MAX_REQ_HDR_LEN=1024

# LVGL 9
CONFIG_LV_COLOR_DEPTH_16=y
CONFIG_LV_OS_NONE=y
CONFIG_LV_DEF_REFR_PERIOD=15
CONFIG_LV_USE_CLIB_MALLOC=y
CONFIG_LV_USE_CLIB_STRING=y
CONFIG_LV_USE_CLIB_SPRINTF=y
CONFIG_LV_DRAW_BUF_ALIGN=64
CONFIG_LV_FONT_MONTSERRAT_14=y
CONFIG_LV_FONT_MONTSERRAT_16=y
CONFIG_LV_FONT_MONTSERRAT_20=y
CONFIG_LV_FONT_MONTSERRAT_24=y
CONFIG_LV_FONT_MONTSERRAT_28=y
CONFIG_LV_FONT_MONTSERRAT_32=y
CONFIG_LV_FONT_MONTSERRAT_40=y
CONFIG_LV_FONT_DEFAULT_MONTSERRAT_20=y
CONFIG_LV_USE_THEME_DEFAULT=y
CONFIG_LV_THEME_DEFAULT_DARK=y
CONFIG_LV_USE_KEYBOARD=y
CONFIG_LV_USE_TEXTAREA=y
CONFIG_LV_USE_CANVAS=y
CONFIG_LV_USE_TABVIEW=y
CONFIG_LV_USE_MSGBOX=y
CONFIG_LV_USE_PERF_MONITOR=n

# esp_lvgl_port: PPA hardware rotation
CONFIG_LVGL_PORT_ENABLE_PPA=y

# ESP LCD touch
CONFIG_ESP_LCD_TOUCH_MAX_POINTS=3

# Logging
CONFIG_LOG_DEFAULT_LEVEL_INFO=y
```
